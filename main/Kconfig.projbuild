## main/Kconfig.projbuild
```kconfig
menu "Genshin UI Hardware"

    config GENSHIN_VIBRATION_INA_PIN
        int "Vibration motor H-bridge INA GPIO (TC118S)"
        default 47

    config GENSHIN_VIBRATION_INB_PIN
        int "Vibration motor H-bridge INB GPIO (TC118S)"
        default 46

    config GENSHIN_BACKLIGHT_PIN
        int "LCD backlight PWM GPIO"
        default 23

    config GENSHIN_BACKLIGHT_PWM_FREQ_HZ
        int "Backlight PWM frequency (Hz)"
        default 20000

    config GENSHIN_BACKLIGHT_DEFAULT_PERCENT
        int "Backlight default brightness (percent)"
        range 1 100
        default 80

    config GENSHIN_BUTTON_PIN
        int "Mode switch button GPIO (active low)"
        default 9

    config GENSHIN_ALERT_MP3_PATH
        string "Proximity alert mp3 path on SD card"
        default "/alert/alert.mp3"

    config GENSHIN_SD_PWR_CTRL_LDO_CHAN
        int "SD card power on-chip LDO channel (-1 = external/always-on supply)"
        default 4
        help
            ESP32-P4 的 SD 卡 VDD 可由内部 LDO 供电（官方 P4 板默认 LDO_VO4=4）。
            如果 SD 卡电源由板上常供电或外部 LDO 提供，设为 -1 跳过。

endmenu
```

## sdkconfig.defaults
```kconfig
# ============================================================
# ESP32-P4 4.3" ST7102 MIPI 原神挂件 - 默认配置
# 基于 ESP-IDF 5.5.x（与参考工程 esp32p4-idf5_st7102_lvgl9 一致）
# ============================================================
CONFIG_IDF_TARGET="esp32p4"
CONFIG_ESPTOOLPY_FLASHSIZE_16MB=y
CONFIG_PARTITION_TABLE_CUSTOM=y
CONFIG_PARTITION_TABLE_CUSTOM_FILENAME="partitions.csv"

# ---- PSRAM（MJPEG 帧缓冲 / LVGL 缓冲 / MP3 解码必需） ----
CONFIG_SPIRAM=y
CONFIG_SPIRAM_SPEED_200M=y
CONFIG_SPIRAM_XIP_FROM_PSRAM=y
CONFIG_SPIRAM_USE_MALLOC=y

# ---- 缓存与性能 ----
CONFIG_CACHE_L2_CACHE_256KB=y
CONFIG_CACHE_L2_CACHE_LINE_128B=y
CONFIG_COMPILER_OPTIMIZATION_PERF=y
CONFIG_ESP_MAIN_TASK_STACK_SIZE=10240
CONFIG_FREERTOS_HZ=1000

# ---- FATFS：启用长文件名（否则 .mjpeg 被截成 8.3 短名 .MJP 无法匹配） ----
CONFIG_FATFS_LFN_HEAP=y

# ---- LVGL 9（中文界面用内置思源黑体 16px） ----
CONFIG_LV_USE_CLIB_MALLOC=y
CONFIG_LV_USE_CLIB_STRING=y
CONFIG_LV_USE_CLIB_SPRINTF=y
CONFIG_LV_DEF_REFR_PERIOD=15
CONFIG_LV_OS_FREERTOS=y
CONFIG_LV_DRAW_SW_DRAW_UNIT_CNT=2
CONFIG_LV_FONT_MONTSERRAT_14=y
CONFIG_LV_FONT_MONTSERRAT_16=y
CONFIG_LV_FONT_MONTSERRAT_20=y
CONFIG_LV_FONT_MONTSERRAT_48=y
CONFIG_LV_FONT_SOURCE_HAN_SANS_SC_16_CJK=y
CONFIG_LV_FONT_DEFAULT_SOURCE_HAN_SANS_SC_16_CJK=y
CONFIG_LV_USE_FONT_PLACEHOLDER=y
# 字体放 SD 卡（/sdcard/font/*.bin），运行时加载，不占 flash
CONFIG_LV_USE_FS_POSIX=y
CONFIG_LV_FS_POSIX_LETTER=83
CONFIG_LV_USE_FONT_COMPRESSED=y
CONFIG_LV_FONT_FMT_TXT_LARGE=y
# LVGL 日志（诊断 binfont 加载失败原因用）
CONFIG_LV_USE_LOG=y
CONFIG_LV_LOG_LEVEL=LV_LOG_LEVEL_WARN
# esp_lvgl_port：关闭 PPA（PPA 偶发卡死导致 LVGL 渲染死锁，改用软件旋转）
CONFIG_LVGL_PORT_ENABLE_PPA=n
CONFIG_ESP32P4_SELECTS_REV_LESS_V3=y
CONFIG_IDF_EXPERIMENTAL_FEATURES=y

# ---- 蓝牙：host-only，控制器在 C6 上，经 esp-hosted VHCI 传输 ----
CONFIG_BT_ENABLED=y
CONFIG_BT_CONTROLLER_DISABLED=y
CONFIG_BT_NIMBLE_ENABLED=y
CONFIG_BT_NIMBLE_TRANSPORT_UART=n

# ---- ESP-Hosted：外挂 ESP32-C6 经 SDIO 接入，提供 WiFi + BLE ----
CONFIG_ESP_HOSTED_ENABLED=y
CONFIG_ESP_HOSTED_CP_TARGET_ESP32C6=y
CONFIG_ESP_HOSTED_IDF_SLAVE_TARGET="esp32c6"
CONFIG_ESP_HOSTED_P4_DEV_BOARD_NONE=y
CONFIG_ESP_HOSTED_PRIV_ENABLE_WIFI_OPTIONS=y
CONFIG_ESP_HOSTED_PRIV_SDIO_OPTION=y
CONFIG_ESP_HOSTED_SDIO_HOST_INTERFACE=y
CONFIG_ESP_HOSTED_SDIO_RESET_ACTIVE_HIGH=y
CONFIG_ESP_HOSTED_SDIO_SLOT_1=y
CONFIG_ESP_HOSTED_SDIO_4_BIT_BUS=y
CONFIG_ESP_HOSTED_SDIO_CLOCK_FREQ_KHZ=40000
CONFIG_ESP_HOSTED_SDIO_OPTIMIZATION_RX_STREAMING_MODE=y
# SDIO 引脚（P4 侧）：CLK=18 CMD=19 D0=14 D1=15 D2=16 D3=17 Reset=54
CONFIG_ESP_HOSTED_PRIV_SDIO_PIN_CMD_SLOT_1=19
CONFIG_ESP_HOSTED_PRIV_SDIO_PIN_CLK_SLOT_1=18
CONFIG_ESP_HOSTED_PRIV_SDIO_PIN_D0_SLOT_1=14
CONFIG_ESP_HOSTED_PRIV_SDIO_PIN_D1_4BIT_BUS_SLOT_1=15
CONFIG_ESP_HOSTED_PRIV_SDIO_PIN_D2_4BIT_BUS_SLOT_1=16
CONFIG_ESP_HOSTED_PRIV_SDIO_PIN_D3_4BIT_BUS_SLOT_1=17
CONFIG_ESP_HOSTED_SDIO_PIN_CMD=19
CONFIG_ESP_HOSTED_SDIO_PIN_CLK=18
CONFIG_ESP_HOSTED_SDIO_PIN_D0=14
CONFIG_ESP_HOSTED_SDIO_PIN_D1=15
CONFIG_ESP_HOSTED_SDIO_PIN_D2=16
CONFIG_ESP_HOSTED_SDIO_PIN_D3=17
CONFIG_ESP_HOSTED_SDIO_GPIO_RESET_SLAVE=54
CONFIG_ESP_HOSTED_GPIO_SLAVE_RESET_SLAVE=54
CONFIG_ESP_HOSTED_SLAVE_RESET_ON_EVERY_HOST_BOOTUP=y
CONFIG_ESP_HOSTED_SDIO_RESET_DELAY_MS=1500
# Hosted BLE：NimBLE 走 VHCI 复用 SDIO 传输
CONFIG_ESP_HOSTED_ENABLE_BT_NIMBLE=y
CONFIG_ESP_HOSTED_NIMBLE_HCI_VHCI=y
# P4 上 GDMA 可达 PSRAM：传输缓冲优先用 SPIRAM，避免 internal DMA RAM 不足
CONFIG_ESP_HOSTED_MEMPOOL_PREFER_SPIRAM=y

# ---- WiFi 走 esp-hosted（esp_wifi_remote 组件提供标准 esp_wifi API） ----
CONFIG_ESP_WIFI_REMOTE_ENABLED=y
CONFIG_ESP_WIFI_REMOTE_LIBRARY_HOSTED=y
CONFIG_ESP_WIFI_REMOTE_IDF_SPECIFIC_ADDED=y

# LVGL：启用内存文件系统（字体从 flash 内存加载 lv_binfont_create_from_buffer）
CONFIG_LV_USE_FS_MEMFS=y
CONFIG_LV_FS_MEMFS_LETTER=65

# esp-serial-flasher：启用 SDIO port（P4 直接刷空白 C6）
CONFIG_SERIAL_FLASHER_PORT_SDIO=y
```
